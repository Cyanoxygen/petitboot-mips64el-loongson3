## configs/loongson3_pb_minimal_defconfig
```kconfig
BR2_mips64el=y
BR2_mips_64r2=y
BR2_MIPS_NABI64=y
# BR2_MIPS_SOFT_FLOAT is not set
BR2_TOOLCHAIN_BUILDROOT_MUSL=y
BR2_GLOBAL_PATCH_DIR="board/loongson3/patches"
BR2_TARGET_GENERIC_HOSTNAME="petitboot-ls3a"
BR2_TARGET_GENERIC_ISSUE="Welcome to Petitboot!"
BR2_ROOTFS_DEVICE_CREATION_DYNAMIC_EUDEV=y
BR2_ROOTFS_MERGED_USR=y
BR2_TARGET_GENERIC_ROOT_PASSWD="root"
BR2_SYSTEM_BIN_SH_BASH=y
BR2_ENABLE_LOCALE_WHITELIST="C en_US de_DE es_ES fr_FR it_IT ja_JP ko_KR pt_BT ru_RU vi_VN zh_CN zh_TW"
BR2_SYSTEM_ENABLE_NLS=y
BR2_ROOTFS_POST_BUILD_SCRIPT="board/loongson3/scripts/pb-post.sh"
BR2_LINUX_KERNEL=y
BR2_LINUX_KERNEL_USE_CUSTOM_CONFIG=y
BR2_LINUX_KERNEL_CUSTOM_CONFIG_FILE="board/loongson3/configs/pb-minimal.cfg"
BR2_LINUX_KERNEL_IMAGE_TARGET_CUSTOM=y
BR2_LINUX_KERNEL_XZ=y
BR2_LINUX_KERNEL_IMAGE_TARGET_NAME="vmlinuz"
BR2_LINUX_KERNEL_IMAGE_NAME="../../../vmlinuz"
BR2_PACKAGE_BUSYBOX_SHOW_OTHERS=y
BR2_PACKAGE_KEXEC_ZLIB=y
BR2_PACKAGE_LINUX_FIRMWARE=y
BR2_PACKAGE_LINUX_FIRMWARE_AMDGPU=y
BR2_PACKAGE_LINUX_FIRMWARE_RADEON=y
BR2_PACKAGE_EUDEV_RULES_GEN=y
# BR2_PACKAGE_EUDEV_ENABLE_HWDB is not set
BR2_PACKAGE_KMOD_TOOLS=y
BR2_PACKAGE_PETITBOOT=y
BR2_PACKAGE_PETITBOOT_GETTY_PORT="console ttyS*"
BR2_TARGET_ROOTFS_CPIO=y
BR2_TARGET_ROOTFS_CPIO_ZSTD=y
# BR2_TARGET_ROOTFS_TAR is not set
BR2_PACKAGE_HOST_KMOD_GZ=y
BR2_PACKAGE_HOST_KMOD_ZSTD=y
BR2_PACKAGE_HOST_KMOD_XZ=y
```
